## firmware/product/components/stock/Kconfig
```kconfig
menu "OpenDeskNode"

config STOCK_GATEWAY_BASE_URL
    string "LAN Stock Gateway base URL"
    default "http://stock-gateway.local:8000"
    help
        LAN-only HTTP endpoint reachable by this node. Change it to your
        Gateway host name or LAN IP. Do not put credentials or secrets here.

config STOCK_GATEWAY_DEVICE_ID
    string "Stock Gateway device id"
    default "device-a"

config STOCK_GATEWAY_TIMEOUT_MS
    int "Dashboard request timeout (milliseconds)"
    range 1000 30000
    default 8000

endmenu
```

## firmware/product/components/voice/Kconfig
```kconfig
menu "EVA Voice Bridge client"

config VOICE_BRIDGE_URI
    string "EVA Voice Bridge WebSocket URI"
    default "ws://eva-bridge.local:8090/voice/v0"
    help
        LAN-only Voice Bridge endpoint. The default is a portable mDNS-style
        placeholder: set the real site value (stable hostname preferred over
        LAN IP) in the local gitignored sdkconfig, never in this file. Do not
        put tokens or OpenClaw URLs here.

config VOICE_DEVICE_ID
    string "Device id sent in hello"
    default "opendesk-a"

config VOICE_UTTERANCE_MS
    int "Manual utterance capture duration (milliseconds)"
    range 1000 15000
    default 5000

choice VOICE_WAKE_SOURCE
    prompt "Wake source"
    default VOICE_WAKE_SOURCE_NONE
    help
        Product wake phrase is 你好 EVA. No confirmed custom WakeNet model
        is available; status is WAKE MODEL PENDING. BOOT is a manual trigger
        and is counted separately from mock/wake hits.

config VOICE_WAKE_SOURCE_NONE
    bool "None (BOOT/manual only)"

config VOICE_WAKE_SOURCE_MOCK
    bool "Mock wake provider"

endchoice

endmenu
```
